// File generated 3/27/2023 5:58:44 PM
// Warning! This is a generated file, any manual changes will be
// lost during the next generation.

#constant  IFONT_OFFSET     0
// object indexes into WIDGET pointer
#CONST
    iISwitch0
#END

// object indexes into ImageControl
#CONST
    iWinbutton0     // offset 0x0
    iWinbutton1     // offset 0x4200
    iWinbutton2     // offset 0x6E00
    iUserled0       // offset 0xB000
    iLeddigits0     // offset 0xD800
    iiLeddigits0    // offset 0xFA00
    iStatictext0    // offset 0x14E00
    iStatictext1    // offset 0x15800
    iStatictext2    // offset 0x16200
    iStatictext3    // offset 0x16C00
#END



#IFNOT EXISTS NOGLOBALS
var hndl ;
#ENDIF
