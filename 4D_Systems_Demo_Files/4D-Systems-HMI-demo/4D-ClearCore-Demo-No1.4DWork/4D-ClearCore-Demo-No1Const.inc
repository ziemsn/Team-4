// File generated 1/20/2023 11:32:49 AM
// Warning! This is a generated file, any manual changes will be
// lost during the next generation.

#DATA
    byte iKeyboard0keystrokes 0x37, 0x38, 0x39, 0x34, 0x35, 0x36, 0x31, 0x32, 0x33, 0x0D, 0x30, 0x08
#END


#constant  IFONT_OFFSET     0
// object indexes into FlashBank Functions
#CONST
    Fgfx_Button5                1
    Fgfx_Label2                 2  // Genie, double byte string from RAM
    Fgfx_MediaButton            3
    Fgfx_MediaGauge             4
    Fgfx_MediaPanel             5
    Fgfx_MediaRotary            6
    Fgfx_MediaSlider            7
    Fgfx_MediaThermometer       8
    Fgfx_Slider3                9
    Fgfx_Slider4                10
    Fgfx_Slider6                11
    Fgfx_Slider7                12
    Fgfx_Slider8                13
    Fgfx_Switch2                14
#END
// object indexes into ImageControl
#CONST
    iVideo0         // offset 0x0
    iVideo1         // offset 0xB0A00
    iVideo2         // offset 0x161400
    iVideo3         // offset 0x211E00
    iStatictext0    // offset 0x2D2A00
    iWinbutton0     // offset 0x2D4800
    iWinbutton1     // offset 0x2D8600
    iWinbutton2     // offset 0x2DC400
    i4Dbutton0      // offset 0x2E0200
    i4Dbutton1      // offset 0x2E4400
    iStatictext1    // offset 0x2E8600
    iStatictext2    // offset 0x2E9000
    i4Dbutton2      // offset 0x2E9800
    i4Dbutton3      // offset 0x2EDA00
    i4Dbutton4      // offset 0x2F1C00
    i4Dbutton5      // offset 0x2F5E00
    iVideo4         // offset 0x2FA000
    iVideo5         // offset 0x343400
    iVideo6         // offset 0x38C800
    iStatictext3    // offset 0x3D5C00
    iStatictext4    // offset 0x3D6800
    iLeddigits0     // offset 0x3D9A00
    iiLeddigits0    // offset 0x3DC200
    iStatictext5    // offset 0x3E1600
    iStatictext6    // offset 0x3E2E00
    iLeddigits1     // offset 0x3E3C00
    iiLeddigits1    // offset 0x3E6400
    iStatictext7    // offset 0x3EB800
    iLeddigits2     // offset 0x3EC600
    iiLeddigits2    // offset 0x3EE600
    iStatictext8    // offset 0x3F3A00
    iLeddigits3     // offset 0x3F4C00
    iiLeddigits3    // offset 0x3F6C00
    iStatictext9    // offset 0x3FC000
    iLeddigits4     // offset 0x3FCA00
    iiLeddigits4    // offset 0x3FEA00
    iWinbutton3     // offset 0x403E00
    iVideo7         // offset 0x406C00
    iLeddigits5     // offset 0x52BC00
    iiLeddigits5    // offset 0x52D600
    iStatictext10   // offset 0x532A00
    iWinbutton4     // offset 0x533600
    iWinbutton5     // offset 0x534A00
    iWinbutton6     // offset 0x535E00
    iWinbutton7     // offset 0x537200
    iStatictext11   // offset 0x538600
    iStatictext12   // offset 0x538E00
    iStatictext13   // offset 0x539400
    i4Dbutton6      // offset 0x539C00
    iUserled0       // offset 0x53C200
    iStatictext14   // offset 0x53D600
    iStatictext15   // offset 0x53DC00
    iStatictext16   // offset 0x53E600
    i4Dbutton7      // offset 0x53FA00
    iStatictext17   // offset 0x544400
    iStatictext18   // offset 0x547600
    iLeddigits6     // offset 0x548E00
    iiLeddigits6    // offset 0x54B600
    iLeddigits7     // offset 0x550A00
    iiLeddigits7    // offset 0x553200
    iLeddigits8     // offset 0x558600
    iiLeddigits8    // offset 0x55A600
    iLeddigits9     // offset 0x55FA00
    iiLeddigits9    // offset 0x561A00
    iLeddigits10    // offset 0x566E00
    iiLeddigits10   // offset 0x568E00
    iStatictext19   // offset 0x56E200
    iLeddigits11    // offset 0x56F000
    iiLeddigits11   // offset 0x570A00
    iVideo8         // offset 0x575E00
    iWinbutton8     // offset 0x893800
    iWinbutton9     // offset 0x896600
    iWinbutton10    // offset 0x897A00
    iWinbutton11    // offset 0x898E00
    iWinbutton12    // offset 0x89A200
    iStatictext20   // offset 0x89B600
    iStatictext21   // offset 0x89C400
    iStatictext22   // offset 0x89CC00
    iStatictext23   // offset 0x89DA00
    iStatictext24   // offset 0x89E000
    iStatictext25   // offset 0x89F200
    iStatictext26   // offset 0x89FA00
    iStatictext27   // offset 0x8A0400
    i4Dbutton8      // offset 0x8A0E00
    iStatictext28   // offset 0x8A3400
    iUserled1       // offset 0x8A3A00
    iStatictext29   // offset 0x8A4E00
    iStatictext30   // offset 0x8A8000
    iLeddigits12    // offset 0x8A9800
    iiLeddigits12   // offset 0x8AC000
    iLeddigits13    // offset 0x8B1400
    iiLeddigits13   // offset 0x8B3C00
    iLeddigits14    // offset 0x8B9000
    iiLeddigits14   // offset 0x8BB000
    iLeddigits15    // offset 0x8C0400
    iiLeddigits15   // offset 0x8C2400
    iLeddigits16    // offset 0x8C7800
    iiLeddigits16   // offset 0x8C9800
    iStatictext31   // offset 0x8CEC00
    iLeddigits17    // offset 0x8CFA00
    iiLeddigits17   // offset 0x8D1400
    iVideo9         // offset 0x8D6800
    iWinbutton13    // offset 0xBF4200
    iWinbutton14    // offset 0xBF7000
    iWinbutton15    // offset 0xBF8400
    iWinbutton16    // offset 0xBF9800
    iWinbutton17    // offset 0xBFAC00
    iStatictext32   // offset 0xBFC000
    iStatictext33   // offset 0xBFCE00
    iStatictext34   // offset 0xBFD600
    iStatictext35   // offset 0xBFE400
    iStatictext36   // offset 0xBFEA00
    iStatictext37   // offset 0xBFFC00
    iStatictext38   // offset 0xC00400
    iStatictext39   // offset 0xC00E00
    i4Dbutton9      // offset 0xC01800
    iStatictext40   // offset 0xC03E00
    iUserled2       // offset 0xC04400
    iStatictext41   // offset 0xC05800
    iKeyboard0      // offset 0xC07C00
    iKeyboard0_0    // offset 0xC2A000
    iKeyboard0_1    // offset 0xC2FA00
    iKeyboard0_2    // offset 0xC35400
    iKeyboard0_3    // offset 0xC3AE00
    iKeyboard0_4    // offset 0xC40800
    iKeyboard0_5    // offset 0xC46200
    iKeyboard0_6    // offset 0xC4BC00
    iKeyboard0_7    // offset 0xC51600
    iKeyboard0_8    // offset 0xC57000
    iKeyboard0_9    // offset 0xC5CA00
    iKeyboard0_10   // offset 0xC62400
    iKeyboard0_11   // offset 0xC67E00
    iLeddigits18    // offset 0xC6D800
    iiLeddigits18   // offset 0xC70000
    iWinbutton18    // offset 0xC75400
#END



#IFNOT EXISTS NOGLOBALS
var hndl ;
var oKeyboard0[12] := [-1, 0, 0, 0, 0, 255, 255, 255, 255, 255, 12, 0] ;
#ENDIF
