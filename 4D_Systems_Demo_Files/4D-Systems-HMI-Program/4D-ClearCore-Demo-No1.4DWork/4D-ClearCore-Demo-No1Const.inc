// File generated 3/27/2023 6:14:05 PM
// Warning! This is a generated file, any manual changes will be
// lost during the next generation.

#DATA
    byte iKeyboard0keystrokes 0x37, 0x38, 0x39, 0x34, 0x35, 0x36, 0x31, 0x32, 0x33, 0x0D, 0x30, 0x08
#END


#constant  IFONT_OFFSET     0
// object indexes into WIDGET pointer
#CONST
    iISwitch0
#END

// object indexes into ImageControl
#CONST
    iImage0         // offset 0x0
    iStatictext0    // offset 0x3F800
    iLeddigits0     // offset 0x41A00
    iiLeddigits0    // offset 0x45400
    iWinbutton0     // offset 0x4B200
    iStatictext1    // offset 0x4D600
    iStatictext2    // offset 0x4E600
    iUserled0       // offset 0x4EC00
    iStatictext3    // offset 0x53000
    iWinbutton1     // offset 0x53600
    iWinbutton2     // offset 0x58200
    iKeyboard0      // offset 0x6B000
    iKeyboard0_0    // offset 0x90A00
    iKeyboard0_1    // offset 0x96E00
    iKeyboard0_2    // offset 0x9D200
    iKeyboard0_3    // offset 0xA3600
    iKeyboard0_4    // offset 0xA9A00
    iKeyboard0_5    // offset 0xAFE00
    iKeyboard0_6    // offset 0xB6200
    iKeyboard0_7    // offset 0xBC600
    iKeyboard0_8    // offset 0xC2A00
    iKeyboard0_9    // offset 0xC8E00
    iKeyboard0_10   // offset 0xCF200
    iKeyboard0_11   // offset 0xD5600
    iLeddigits1     // offset 0xDBA00
    iiLeddigits1    // offset 0xDF400
    iWinbutton3     // offset 0xE5200
    iStatictext4    // offset 0xE8000
    iStatictext5    // offset 0xE8E00
    iStatictext6    // offset 0xE9C00
    iStatictext7    // offset 0xEFE00
    iWinbutton4     // offset 0xF9600
    iStatictext8    // offset 0xFD800
    iStatictext9    // offset 0x100C00
    iWinbutton5     // offset 0x10DE00
    iWinbutton6     // offset 0x117600
    iStatictext10   // offset 0x11B800
    iStatictext11   // offset 0x128A00
    iWinbutton7     // offset 0x12B600
    iStatictext12   // offset 0x13BE00
    iWinbutton8     // offset 0x153C00
    iWinbutton9     // offset 0x15D000
#END



#IFNOT EXISTS NOGLOBALS
var hndl ;
var oKeyboard0[12] := [-1, 0, 0, 0, 0, 255, 255, 255, 255, 255, 12, 0] ;
#ENDIF
