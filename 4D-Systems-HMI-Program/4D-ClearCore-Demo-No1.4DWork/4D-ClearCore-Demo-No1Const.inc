// File generated 3/21/2023 2:04:47 PM
// Warning! This is a generated file, any manual changes will be
// lost during the next generation.

#DATA
    byte iKeyboard0keystrokes 0x37, 0x38, 0x39, 0x34, 0x35, 0x36, 0x31, 0x32, 0x33, 0x0D, 0x30, 0x08
#END


#constant  IFONT_OFFSET     0
// object indexes into WIDGET pointer
#CONST
    iISwitch0
#END

// object indexes into ImageControl
#CONST
    iImage0         // offset 0x0
    iStatictext17   // offset 0x3F800
    iLeddigits7     // offset 0x41A00
    iiLeddigits7    // offset 0x45400
    iWinbutton9     // offset 0x4B200
    iStatictext20   // offset 0x4D600
    iStatictext28   // offset 0x4E600
    iUserled1       // offset 0x4EC00
    iStatictext19   // offset 0x53000
    iWinbutton8     // offset 0x53A00
    iWinbutton12    // offset 0x58600
    iKeyboard0      // offset 0x6B400
    iKeyboard0_0    // offset 0x90E00
    iKeyboard0_1    // offset 0x97200
    iKeyboard0_2    // offset 0x9D600
    iKeyboard0_3    // offset 0xA3A00
    iKeyboard0_4    // offset 0xA9E00
    iKeyboard0_5    // offset 0xB0200
    iKeyboard0_6    // offset 0xB6600
    iKeyboard0_7    // offset 0xBCA00
    iKeyboard0_8    // offset 0xC2E00
    iKeyboard0_9    // offset 0xC9200
    iKeyboard0_10   // offset 0xCF600
    iKeyboard0_11   // offset 0xD5A00
    iLeddigits18    // offset 0xDBE00
    iiLeddigits18   // offset 0xDF800
    iWinbutton18    // offset 0xE5600
    iStatictext4    // offset 0xE8400
    iStatictext5    // offset 0xE9200
    iStatictext0    // offset 0xEA000
    iStatictext1    // offset 0xF0200
    iWinbutton4     // offset 0xF9A00
    iStatictext2    // offset 0xFDC00
    iStatictext3    // offset 0x101000
    iWinbutton0     // offset 0x10E200
    iWinbutton3     // offset 0x117A00
    iStatictext18   // offset 0x11BC00
    iStatictext21   // offset 0x128E00
    iWinbutton1     // offset 0x12BA00
    iStatictext22   // offset 0x13C200
    iWinbutton2     // offset 0x154000
    iWinbutton10    // offset 0x15D400
#END



#IFNOT EXISTS NOGLOBALS
var hndl ;
var oKeyboard0[12] := [-1, 0, 0, 0, 0, 255, 255, 255, 255, 255, 12, 0] ;
#ENDIF
