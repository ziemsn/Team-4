// File generated 4/13/2023 4:00:24 PM
// Warning! This is a generated file, any manual changes will be
// lost during the next generation.

#DATA
    byte iKeyboard0keystrokes 0x37, 0x38, 0x39, 0x34, 0x35, 0x36, 0x31, 0x32, 0x33, 0x08, 0x30, 0x0D
#END


#constant  IFONT_OFFSET     0
// object indexes into WIDGET pointer
#CONST
    iISwitch0
    iISwitch1
#END

// object indexes into ImageControl
#CONST
    iImage0         // offset 0x0
    iWinbutton0     // offset 0x3F000
    iWinbutton1     // offset 0x4BA00
    iWinbutton2     // offset 0x51800
    iLeddigits0     // offset 0x54200
    iiLeddigits0    // offset 0x58000
    iStatictext0    // offset 0x5FA00
    iStatictext1    // offset 0x61600
    iStatictext2    // offset 0x64200
    iStatictext3    // offset 0x64600
    iUserled0       // offset 0x64A00
    iWinbutton3     // offset 0x6A200
    iStatictext4    // offset 0x70000
    iWinbutton4     // offset 0x93600
    iWinbutton5     // offset 0x99600
    iStatictext5    // offset 0xA0800
    iStatictext7    // offset 0xB4800
    iWinbutton6     // offset 0xD9E00
    iWinbutton7     // offset 0xE0C00
    iWinbutton8     // offset 0xEB200
    iStatictext9    // offset 0xF5A00
    iKeyboard0      // offset 0xFE200
    iKeyboard0_0    // offset 0x11FE00
    iKeyboard0_1    // offset 0x125600
    iKeyboard0_2    // offset 0x12AE00
    iKeyboard0_3    // offset 0x130600
    iKeyboard0_4    // offset 0x135E00
    iKeyboard0_5    // offset 0x13B600
    iKeyboard0_6    // offset 0x140E00
    iKeyboard0_7    // offset 0x146600
    iKeyboard0_8    // offset 0x14BE00
    iKeyboard0_9    // offset 0x151600
    iKeyboard0_10   // offset 0x156E00
    iKeyboard0_11   // offset 0x15C600
    iWinbutton9     // offset 0x161E00
    iLeddigits1     // offset 0x166C00
    iiLeddigits1    // offset 0x169C00
    iStatictext6    // offset 0x16FA00
#END



#IFNOT EXISTS NOGLOBALS
var hndl ;
var oKeyboard0[12] := [-1, 0, 0, 0, 0, 255, 255, 255, 255, 255, 12, 0] ;
#ENDIF
